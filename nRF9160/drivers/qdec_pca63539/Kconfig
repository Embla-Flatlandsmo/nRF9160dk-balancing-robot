## nRF9160/drivers/qdec_pca63539/Kconfig
```kconfig
menuconfig QDEC_PCA63539
    bool "Enable PCA63539 QDEC driver"
    depends on SENSOR && I2C

if QDEC_PCA63539

module = QDEC_PCA63539_DRIVER
module-str = qdec pca63539 driver
source "subsys/logging/Kconfig.template.log_config"

endif
```

## nRF9160/src/events/Kconfig
```kconfig
#
# Copyright (c) 2022 Nordic Semiconductor
#
# SPDX-License-Identifier: LicenseRef-Nordic-5-Clause
#

menuconfig EVENTS
	bool "Event options"
	default y

if EVENTS

config IMU_EVENTS_LOG
	bool "Enable logging for IMU module events"
	default n


config QDEC_EVENTS_LOG
	bool "Enable logging for QDEC module events"
	default y

if PROFILER

choice
	prompt "Event type format for profiler"
	default PROFILER_EVENT_TYPE_INT

config PROFILER_EVENT_TYPE_STRING
	bool "Event type as string"

config PROFILER_EVENT_TYPE_INT
	bool "Event type as integer"

endchoice

endif # PROFILER

endif # EVENTS
```

## nRF9160/src/modules/Kconfig.controller_module
```kconfig
#
# Copyright (c) 2022 Nordic Semiconductor
#
# SPDX-License-Identifier: LicenseRef-Nordic-5-Clause
#

menuconfig CONTROLLER_MODULE
	bool "Controller module"
	default y

if CONTROLLER_MODULE

config CONTROLLER_THREAD_STACK_SIZE
	int "Controller module thread stack size"
	default 2048

config STATIC_SET_POINT_PITCH
    int "Static set point used as an 'anchor' when changing pitch set point"
    help
      This is manually set by finding the pitch angle at which the robot balances without input
    default -90

config STATIC_SET_POINT_SPEED
    int "Static set point is used as an 'anchor' when changing speed set point"
    default 0

config ANGLE_FAILSAFE_LIMIT
    int "Absolute value of angle above which the motors will shut down to fail predictably"
    default 20

# PID controller stuff
config ENABLE_FEEDFORWARD
    bool "Additional feedforward control"
    default n

config DEGREES_RANGE_PITCH
    int "Allowed range of degrees when changing set point for pitch"
    default 5

config DEGREES_RANGE_YAW
    int "Allowed range of degrees when changing set point for yaw"
    default 180

config SPEED_RANGE
    int "Max horizontal speed factor. Divided by 100 in the code"
    default 4

## Pitch PID
### TODO: Tune these
config KP_PITCH
    int "Proportional gain of PID controller for pitch"
    default 18000
    # default 180000
    # default 180000

config KI_PITCH
    int "Integral gain of PID controller for pitch"
    default 0
    # default 130000

config KD_PITCH
    int "Derivative gain of PID controller for pitch"
    default 3600
    # default 2500

config PITCH_INTEGRATION_LIMITS
    int "Upper and lower integration limits of pitch PID"
    default 400

## Speed PID

config KP_SPEED
    int "Proportional gain of PID controller for speed"
    default 80

config KI_SPEED
    int "Integral gain of PID controller for speed"
    default 90

config KD_SPEED
    int "Derivative gain of PID controller for speed"
    default 4

config SPEED_INTEGRATION_LIMITS
    int "Upper and lower integration limits of speed PID"
    default 10

config SPEED_OUTPUT_LIMITS
    int "Upper and lower output limits of speed PID"
    default 10

## Motor scalings
config MOTOR_CONSTANT
    int "Scales controller output to motor range"
    default 20
endif # CONTROLLER_MODULE

module = CONTROLLER_MODULE
module-str = Controller module
source "subsys/logging/Kconfig.template.log_config"
```

## nRF9160/src/modules/Kconfig.imu_module
```kconfig
#
# Copyright (c) 2022 Nordic Semiconductor
#
# SPDX-License-Identifier: LicenseRef-Nordic-5-Clause
#

menuconfig IMU_MODULE
	bool "IMU module"
	default y

if IMU_MODULE

config IMU_THREAD_STACK_SIZE
	int "Sensor module thread stack size"
	default 2048

config IMU_MESSAGE_FREQUENCY
	int "Number of event messages per second"
	default 1

endif # IMU_MODULE

module = IMU_MODULE
module-str = IMU module
source "subsys/logging/Kconfig.template.log_config"
```

## nRF9160/src/modules/Kconfig.qdec_module
```kconfig
#
# Copyright (c) 2022 Nordic Semiconductor
#
# SPDX-License-Identifier: LicenseRef-Nordic-5-Clause
#

menuconfig QDEC_MODULE
	bool "QDEC module"
	default y

if QDEC_MODULE

config QDEC_THREAD_STACK_SIZE
	int "Sensor module thread stack size"
	default 2048

config QDEC_MESSAGE_FREQUENCY
	int "Number of event messages per second"
	default 50

endif # QDEC_MODULE

module = QDEC_MODULE
module-str = QDEC module
source "subsys/logging/Kconfig.template.log_config"
```

## nRF9160/src/util/Kconfig
```kconfig
menuconfig PID_UTIL
    bool "Util for PID controller"
    default y

if PID_UTIL
module = PID_UTIL
module-str = PID utilities
source "subsys/logging/Kconfig.template.log_config"
endif # PID_UTIL
```

## west.yml
```yaml
manifest:
  version: "0.10"

  defaults:
    revision: main

  remotes:
    - name: nrfconnect
      url-base: https://github.com/nrfconnect/

  projects:
    - name: sdk-nrf
      remote: nrfconnect
      path: nrf
      revision: 69bfabb5a6248d306977d8247084d4b6ddf405ed
      import: true
      
  self:
    path: balancing_robot_firmware
```
